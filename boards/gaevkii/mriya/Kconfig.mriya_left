## boards/gaevkii/mriya/Kconfig.mriya_left
```kconfig
# Copyright (c) 2023 Andrei Gaevkii
# SPDX-License-Identifier: MIT

config BOARD_MRIYA_LEFT
	select SOC_NRF52840_QIAA
```

## boards/gaevkii/mriya/Kconfig.mriya_right
```kconfig
# Copyright (c) 2023 Andrei Gaevkii
# SPDX-License-Identifier: MIT

config BOARD_MRIYA_RIGHT
	select SOC_NRF52840_QIAA
```
