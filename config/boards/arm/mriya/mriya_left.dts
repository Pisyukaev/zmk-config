/*
 * Copyright (c) 2023 Anderi Gaevskii
 *
 * SPDX-License-Identifier: MIT
 */

/dts-v1/;
#include "mriya.dtsi"

/ {
	chosen {
		zmk,physical_layout = &mriya_left_map;
	};
};

&kscan0 {
	col-gpios
		= <&gpio0 22 GPIO_ACTIVE_HIGH>
		, <&gpio1  0 GPIO_ACTIVE_HIGH>
		, <&gpio1  3 GPIO_ACTIVE_HIGH>
		, <&gpio1  1 GPIO_ACTIVE_HIGH>
		, <&gpio1  2 GPIO_ACTIVE_HIGH>
		, <&gpio1  4 GPIO_ACTIVE_HIGH>
		;
};
